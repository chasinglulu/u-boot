## configs/lua-qemu-virt_defconfig
```kconfig
CONFIG_ARM=y
CONFIG_POSITION_INDEPENDENT=y
CONFIG_SYS_INIT_SP_BSS_OFFSET=262144
CONFIG_SEMIHOSTING=y
CONFIG_USE_ARCH_MEMCPY=y
CONFIG_USE_ARCH_MEMSET=y
# CONFIG_ARM64_SUPPORT_AARCH32 is not set
CONFIG_ARCH_AXERA=y
CONFIG_SYS_TEXT_BASE=0x100200000
CONFIG_SPL_GPIO=y
CONFIG_SPL_LIBCOMMON_SUPPORT=y
CONFIG_SPL_LIBGENERIC_SUPPORT=y
CONFIG_SPL_DM_SPI=y
CONFIG_DEFAULT_DEVICE_TREE="laguna-qemu-virt"
CONFIG_SPL_TEXT_BASE=0x14000000
CONFIG_SYS_PROMPT="LUA$ "
CONFIG_SPL_SERIAL=y
CONFIG_BOOTCOUNT_BOOTLIMIT=3
CONFIG_SPL_SIZE_LIMIT=0x200000
CONFIG_SPL_SIZE_LIMIT_PROVIDE_STACK=0x10000
CONFIG_DEBUG_UART_BASE=0x0E403000
CONFIG_DEBUG_UART_CLOCK=192000000
CONFIG_SPL_SPI_FLASH_SUPPORT=y
CONFIG_SPL_SPI=y
CONFIG_ARMV8_SPL_EXCEPTION_VECTORS=y
CONFIG_AXERA_LUA=y
CONFIG_TARGET_LUA_VIRT=y
CONFIG_LUA_FDT_LOAD_NAME="laguna-qemu-virt.dtb"
CONFIG_LUA_RAMDISK_LOAD_NAME="rootfs.cpio.lz4"
CONFIG_LUA_GICV2_LOWLEVEL_INIT=y
CONFIG_LUA_NOR0=y
CONFIG_LUA_MTDPARTS_NOR0="64k(misc),64k(env),64k(vbmeta_a),64k(vbmeta_b),512k(atf_a),512k(atf_b),512k(optee_a),512k(optee_b),2m(uboot_a),2m(uboot_b)"
CONFIG_LUA_AB=y
CONFIG_LUA_CUSTOM_SERVERIP=y
CONFIG_SYS_LOAD_ADDR=0x102000000
CONFIG_BUILD_TARGET="u-boot.itb"
CONFIG_DEBUG_UART=y
CONFIG_ENV_VARS_UBOOT_CONFIG=y
CONFIG_FIT=y
CONFIG_SPL_FIT_PRINT=y
CONFIG_SPL_LOAD_FIT=y
CONFIG_SPL_LOAD_FIT_ADDRESS=0x100200000
CONFIG_SPL_FIT_SOURCE="arch/arm/mach-axera/laguna/spl-fit.its"
# CONFIG_USE_SPL_FIT_GENERATOR is not set
# CONFIG_BOOTSTD is not set
CONFIG_SUPPORT_RAW_INITRD=y
CONFIG_OF_BOARD_SETUP=y
CONFIG_OF_SYSTEM_SETUP=y
CONFIG_USE_BOOTCOMMAND=y
CONFIG_BOOTCOMMAND="run distro_bootcmd"
CONFIG_CONSOLE_RECORD=y
CONFIG_SYS_CONSOLE_IS_IN_ENV=y
CONFIG_BOARD_TYPES=y
CONFIG_BOARD_LATE_INIT=y
CONFIG_LAST_STAGE_INIT=y
CONFIG_PCI_INIT_R=y
CONFIG_AVB_VERIFY=y
CONFIG_AVB_BUF_ADDR=0x90000000
CONFIG_AVB_BUF_SIZE=0x100000
CONFIG_STACKPROTECTOR=y
CONFIG_SPL_FRAMEWORK_BOARD_INIT_F=y
CONFIG_SPL_SIZE_LIMIT_SUBTRACT_GD=y
CONFIG_SPL_SIZE_LIMIT_SUBTRACT_MALLOC=y
CONFIG_SPL_MAX_SIZE=0x1FE000
CONFIG_SPL_PAD_TO=0x0
CONFIG_SPL_HAS_BSS_LINKER_SECTION=y
CONFIG_SPL_BSS_START_ADDR=0x141C0000
CONFIG_SPL_BSS_MAX_SIZE=0x2000
CONFIG_SPL_SYS_REPORT_STACK_F_USAGE=y
CONFIG_SPL_SHOW_ERRORS=y
CONFIG_SPL_BOARD_INIT=y
CONFIG_SPL_DM_BOOT_DEVICE=y
# CONFIG_SPL_RAW_IMAGE_SUPPORT is not set
CONFIG_SPL_LEGACY_IMAGE_CRC_CHECK=y
CONFIG_SYS_SPL_MALLOC=y
CONFIG_HAS_CUSTOM_SPL_MALLOC_START=y
CONFIG_CUSTOM_SYS_SPL_MALLOC_ADDR=0x101000000
CONFIG_SPL_DISPLAY_PRINT=y
CONFIG_SYS_MMCSD_RAW_MODE_U_BOOT_USE_PARTITION=y
CONFIG_SPL_ENV_SUPPORT=y
CONFIG_SPL_SAVEENV=y
CONFIG_SPL_MULTI_MMC=y
CONFIG_SPL_MMC_WRITE=y
CONFIG_SPL_MULTI_MTD=y
CONFIG_SPL_DM_SPI_FLASH=y
CONFIG_SPL_RAM_SUPPORT=y
CONFIG_SPL_RAM_DEVICE=y
# CONFIG_SPL_SPI_FLASH_TINY is not set
CONFIG_SPL_SPI_FLASH_MTD=y
CONFIG_SPL_SPI_LOAD=y
CONFIG_SPL_YMODEM_SUPPORT=y
CONFIG_SPL_ATF=y
CONFIG_SPL_ATF_LOAD_IMAGE_V2=y
CONFIG_HUSH_PARSER=y
CONFIG_CMD_CONFIG=y
# CONFIG_BOOTM_NETBSD is not set
# CONFIG_BOOTM_PLAN9 is not set
# CONFIG_BOOTM_RTEMS is not set
# CONFIG_BOOTM_VXWORKS is not set
CONFIG_CMD_ABOOTIMG=y
# CONFIG_CMD_ELF is not set
CONFIG_CMD_ASKENV=y
CONFIG_CMD_GREPENV=y
CONFIG_CMD_ERASEENV=y
CONFIG_CMD_ENV_CALLBACK=y
CONFIG_CMD_ENV_FLAGS=y
CONFIG_CMD_NVEDIT_INFO=y
CONFIG_CMD_NVEDIT_LOAD=y
CONFIG_CMD_NVEDIT_SELECT=y
CONFIG_CRC32_VERIFY=y
CONFIG_CMD_MD5SUM=y
CONFIG_MD5SUM_VERIFY=y
CONFIG_CMD_MEMINFO=y
CONFIG_CMD_SHA1SUM=y
CONFIG_SHA1SUM_VERIFY=y
CONFIG_CMD_STRINGS=y
CONFIG_CMD_BCB=y
CONFIG_CMD_BOOTCTRL=y
CONFIG_CMD_BIND=y
CONFIG_CMD_CLK=y
CONFIG_CMD_DM=y
CONFIG_CMD_GPIO=y
CONFIG_CMD_GPT=y
# CONFIG_RANDOM_UUID is not set
CONFIG_CMD_GPT_RENAME=y
CONFIG_CMD_LSBLK=y
CONFIG_CMD_MMC=y
CONFIG_CMD_MMC_SWRITE=y
CONFIG_CMD_MTD=y
CONFIG_CMD_NAND=y
CONFIG_CMD_PART=y
CONFIG_CMD_PCI=y
CONFIG_CMD_POWEROFF=y
CONFIG_CMD_READ=y
CONFIG_CMD_SPI=y
CONFIG_CMD_SETEXPR_FMT=y
CONFIG_CMD_DHCP=y
CONFIG_BOOTP_MAY_FAIL=y
CONFIG_BOOTP_DNS2=y
CONFIG_BOOTP_PREFER_SERVERIP=y
CONFIG_BOOTP_NISDOMAIN=y
CONFIG_BOOTP_NTPSERVER=y
CONFIG_CMD_PCAP=y
CONFIG_CMD_TFTPPUT=y
# CONFIG_CMD_NFS is not set
CONFIG_CMD_MII=y
CONFIG_CMD_PING=y
CONFIG_CMD_DNS=y
CONFIG_CMD_BOOTCOUNT=y
CONFIG_CMD_CACHE=y
CONFIG_CMD_EXCEPTION=y
CONFIG_CMD_TIME=y
CONFIG_CMD_GETTIME=y
CONFIG_CMD_TIMER=y
CONFIG_CMD_SYSBOOT=y
CONFIG_CMD_EXT2=y
CONFIG_CMD_EXT4=y
CONFIG_CMD_EXT4_WRITE=y
CONFIG_CMD_FAT=y
CONFIG_CMD_FS_GENERIC=y
CONFIG_CMD_MTDPARTS=y
CONFIG_CMD_MTDPARTS_SPREAD=y
CONFIG_CMD_MTDPARTS_SHOW_NET_SIZES=y
CONFIG_CMD_AVB=y
CONFIG_MMC_SPEED_MODE_SET=y
# CONFIG_DOS_PARTITION is not set
CONFIG_PARTITION_TYPE_GUID=y
CONFIG_SPL_OF_CONTROL=y
CONFIG_OF_BOARD=y
CONFIG_NET_RETRY_COUNT=20
CONFIG_NET_RANDOM_ETHADDR=y
CONFIG_KEEP_SERVERADDR=y
CONFIG_BOOTP_SERVERIP=y
CONFIG_SPL_DM=y
CONFIG_SPL_DM_WARN=y
# CONFIG_DM_DEVICE_REMOVE is not set
CONFIG_SPL_DM_SEQ_ALIAS=y
CONFIG_SIMPLE_BUS_CORRECT_RANGE=y
CONFIG_SPL_OF_TRANSLATE=y
CONFIG_SPL_BLOCK_CACHE=y
CONFIG_BOOTCOUNT_LIMIT=y
CONFIG_DM_BOOTCOUNT=y
CONFIG_UDP_FUNCTION_FASTBOOT=y
CONFIG_FASTBOOT_BUF_ADDR=0x3090000000
CONFIG_FASTBOOT_BUF_SIZE=0x10000000
CONFIG_FASTBOOT_FLASH=y
CONFIG_FASTBOOT_FLASH_MMC_DEV=1
CONFIG_DWAPB_GPIO=y
# CONFIG_I2C is not set
# CONFIG_INPUT is not set
CONFIG_DM_MAILBOX=y
CONFIG_MISC=y
# CONFIG_MMC_QUIRKS is not set
CONFIG_SUPPORT_EMMC_RPMB=y
CONFIG_SUPPORT_EMMC_BOOT=y
CONFIG_MMC_HS200_SUPPORT=y
CONFIG_MMC_SDHCI=y
CONFIG_MMC_SDHCI_ADMA=y
CONFIG_MMC_SDHCI_LMT=y
CONFIG_MTD=y
CONFIG_DM_MTD=y
CONFIG_SYS_MTDPARTS_RUNTIME=y
CONFIG_MTD_RAW_NAND=y
CONFIG_MTD_SPI_NAND=y
CONFIG_DM_SPI_FLASH=y
CONFIG_SPI_FLASH_STMICRO=y
CONFIG_SPI_FLASH_MT35XU=y
CONFIG_SPI_FLASH_SST=y
CONFIG_SPI_FLASH_MTD=y
CONFIG_DM_MDIO=y
CONFIG_DM_ETH_PHY=y
CONFIG_PHY_GIGE=y
CONFIG_DWC_ETH_QOS=y
CONFIG_DWC_ETH_QOS_LUA=y
CONFIG_E1000=y
CONFIG_CMD_E1000=y
CONFIG_PCI=y
CONFIG_PCIE_ECAM_GENERIC=y
CONFIG_PCI_ENDPOINT=y
CONFIG_PINCTRL=y
CONFIG_PINCONF=y
# CONFIG_POWER is not set
CONFIG_DM_REBOOT_MODE=y
CONFIG_DM_BOOT_DEVICE=y
CONFIG_DM_BOOT_DEVICE_GPIO=y
CONFIG_DM_RESET=y
CONFIG_BAUDRATE=921600
CONFIG_SPECIFY_CONSOLE_INDEX=y
CONFIG_CONS_INDEX=2
CONFIG_SERIAL_RX_BUFFER=y
CONFIG_SERIAL_SEARCH_ALL=y
CONFIG_SERIAL_PROBE_ALL=y
CONFIG_DEBUG_UART_SHIFT=2
CONFIG_SYS_NS16550=y
CONFIG_SPI=y
CONFIG_DM_SPI=y
CONFIG_DESIGNWARE_SPI=y
CONFIG_PL022_SPI=y
CONFIG_VIRTIO_MMIO=y
CONFIG_VIRTIO_PCI=y
CONFIG_VIRTIO_NET=y
CONFIG_VIRTIO_BLK=y
CONFIG_CC_OPTIMIZE_LIBS_FOR_SPEED=y
# CONFIG_SPL_USE_TINY_PRINTF is not set
CONFIG_SPL_TINY_MEMSET=y
CONFIG_LIBAVB=y
CONFIG_SHA384=y
# CONFIG_VPL_LZMA is not set
CONFIG_HEXDUMP=y
CONFIG_SPL_HEXDUMP=y
CONFIG_GETOPT=y
CONFIG_FDT_FIXUP_PARTITIONS=y
# CONFIG_EFI_LOADER is not set
```

## configs/lua-qemu_defconfig
```kconfig
CONFIG_ARM=y
CONFIG_POSITION_INDEPENDENT=y
CONFIG_SYS_INIT_SP_BSS_OFFSET=262144
CONFIG_SEMIHOSTING=y
CONFIG_USE_ARCH_MEMCPY=y
CONFIG_USE_ARCH_MEMSET=y
# CONFIG_ARM64_SUPPORT_AARCH32 is not set
CONFIG_ARCH_AXERA=y
CONFIG_SYS_TEXT_BASE=0x100200000
CONFIG_SYS_MALLOC_F_LEN=0x8000
CONFIG_SPL_GPIO=y
CONFIG_SPL_LIBCOMMON_SUPPORT=y
CONFIG_SPL_LIBGENERIC_SUPPORT=y
CONFIG_DM_GPIO=y
CONFIG_SPL_DM_SPI=y
CONFIG_DEFAULT_DEVICE_TREE="laguna-qemu"
CONFIG_SPL_TEXT_BASE=0x14000000
CONFIG_SYS_PROMPT="LUA$ "
CONFIG_SPL_SERIAL=y
CONFIG_BOOTCOUNT_BOOTLIMIT=3
CONFIG_SPL_SYS_MALLOC_F_LEN=0x4000
CONFIG_SPL_SIZE_LIMIT=0x200000
CONFIG_SPL_SIZE_LIMIT_PROVIDE_STACK=0x10000
CONFIG_DEBUG_UART_BASE=0x0E403000
CONFIG_DEBUG_UART_CLOCK=192000000
CONFIG_SPL_SPI_FLASH_SUPPORT=y
CONFIG_SPL_SPI=y
CONFIG_ARMV8_SPL_EXCEPTION_VECTORS=y
CONFIG_AXERA_LUA=y
CONFIG_TARGET_LUA_VIRT=y
CONFIG_LUA_FDT_LOAD_NAME="laguna-qemu-virt.dtb"
CONFIG_LUA_RAMDISK_LOAD_NAME="rootfs.cpio.lz4"
CONFIG_LUA_GICV2_LOWLEVEL_INIT=y
CONFIG_LUA_SAFETY_INIT=y
CONFIG_LUA_SECURE_BOOT=y
CONFIG_LUA_FIT=y
# CONFIG_SPL_LOAD_MULTI_FIT is not set
CONFIG_LUA_RAS=y
CONFIG_LUA_MTDPARTS_READ=y
CONFIG_LUA_AB=y
CONFIG_LUA_CUSTOM_SERVERIP=y
CONFIG_SYS_LOAD_ADDR=0x102000000
CONFIG_DEBUG_UART=y
CONFIG_ENV_VARS_UBOOT_CONFIG=y
CONFIG_FIT=y
CONFIG_FIT_CIPHER=y
CONFIG_SPL_FIT_CIPHER=y
CONFIG_SPL_FIT_PRINT=y
CONFIG_SPL_FIT_SIGNATURE=y
CONFIG_SPL_LOAD_FIT=y
CONFIG_SPL_LOAD_FIT_ADDRESS=0x100200000
# CONFIG_USE_SPL_FIT_GENERATOR is not set
# CONFIG_BOOTSTD is not set
CONFIG_LEGACY_IMAGE_FORMAT=y
CONFIG_SUPPORT_RAW_INITRD=y
CONFIG_OF_BOARD_SETUP=y
CONFIG_OF_SYSTEM_SETUP=y
CONFIG_USE_BOOTCOMMAND=y
CONFIG_BOOTCOMMAND="run distro_bootcmd"
CONFIG_CONSOLE_RECORD=y
CONFIG_SPL_CONSOLE_RECORD=y
CONFIG_CONSOLE_RECORD_OUT_REUSE=y
CONFIG_CONSOLE_RECORD_ENABLE_INIT=y
CONFIG_CONSOLE_RECORD_FIXED_ADDR=0x102F00000
CONFIG_SYS_CONSOLE_IS_IN_ENV=y
CONFIG_BOARD_TYPES=y
CONFIG_BOARD_LATE_INIT=y
CONFIG_LAST_STAGE_INIT=y
CONFIG_PCI_INIT_R=y
CONFIG_AVB_VERIFY=y
CONFIG_AVB_BUF_ADDR=0x90000000
CONFIG_AVB_BUF_SIZE=0x100000
CONFIG_STACKPROTECTOR=y
CONFIG_SPL_FRAMEWORK_BOARD_INIT_F=y
CONFIG_SPL_SIZE_LIMIT_SUBTRACT_GD=y
CONFIG_SPL_SIZE_LIMIT_SUBTRACT_MALLOC=y
CONFIG_SPL_MAX_SIZE=0x1FE000
CONFIG_SPL_PAD_TO=0x0
CONFIG_SPL_HAS_BSS_LINKER_SECTION=y
CONFIG_SPL_BSS_START_ADDR=0x141C0000
CONFIG_SPL_BSS_MAX_SIZE=0x2000
CONFIG_SPL_SYS_REPORT_STACK_F_USAGE=y
CONFIG_SPL_SHOW_ERRORS=y
CONFIG_SPL_BOARD_INIT=y
# CONFIG_SPL_RAW_IMAGE_SUPPORT is not set
CONFIG_SPL_LEGACY_IMAGE_FORMAT=y
CONFIG_SPL_LEGACY_IMAGE_CRC_CHECK=y
CONFIG_SYS_SPL_MALLOC=y
CONFIG_HAS_CUSTOM_SPL_MALLOC_START=y
CONFIG_CUSTOM_SYS_SPL_MALLOC_ADDR=0x108000000
CONFIG_SYS_SPL_MALLOC_SIZE=0x1000000
CONFIG_SPL_DISPLAY_PRINT=y
CONFIG_SYS_MMCSD_RAW_MODE_U_BOOT_USE_PARTITION=y
CONFIG_SPL_MD5=y
CONFIG_SPL_ENV_SUPPORT=y
CONFIG_SPL_SAVEENV=y
CONFIG_SPL_MMC_WRITE=y
CONFIG_SPL_MULTI_BLK=y
CONFIG_SPL_MULTI_FAT=y
CONFIG_SPL_MULTI_UART=y
CONFIG_SPL_SPINAND_SUPPORT=y
CONFIG_SPL_DM_SPI_FLASH=y
CONFIG_SPL_OS_BOOT=y
CONFIG_SYS_SPL_ARGS_ADDR=0x118000000
CONFIG_SPL_RAM_SUPPORT=y
CONFIG_SPL_RAM_DEVICE=y
CONFIG_SPL_OCM_SUPPORT=y
# CONFIG_SPL_SPI_FLASH_TINY is not set
CONFIG_SPL_SPI_FLASH_MTD=y
CONFIG_SPL_ATF=y
CONFIG_SPL_ATF_LOAD_IMAGE_V2=y
CONFIG_HUSH_PARSER=y
CONFIG_CMD_CONFIG=y
# CONFIG_BOOTM_NETBSD is not set
# CONFIG_BOOTM_PLAN9 is not set
# CONFIG_BOOTM_RTEMS is not set
# CONFIG_BOOTM_VXWORKS is not set
CONFIG_CMD_ABOOTIMG=y
# CONFIG_CMD_ELF is not set
CONFIG_CMD_ASKENV=y
CONFIG_CMD_GREPENV=y
CONFIG_CMD_ERASEENV=y
CONFIG_CMD_ENV_CALLBACK=y
CONFIG_CMD_ENV_FLAGS=y
CONFIG_CMD_NVEDIT_INFO=y
CONFIG_CMD_NVEDIT_LOAD=y
CONFIG_CMD_NVEDIT_SELECT=y
CONFIG_CRC32_VERIFY=y
CONFIG_CMD_MD5SUM=y
CONFIG_MD5SUM_VERIFY=y
CONFIG_CMD_MEMINFO=y
CONFIG_CMD_SHA1SUM=y
CONFIG_SHA1SUM_VERIFY=y
CONFIG_CMD_STRINGS=y
CONFIG_CMD_BCB=y
CONFIG_CMD_BOOTCTRL=y
CONFIG_CMD_BIND=y
CONFIG_CMD_CLK=y
CONFIG_CMD_DFU=y
CONFIG_CMD_DM=y
CONFIG_CMD_GPIO=y
CONFIG_CMD_GPT=y
CONFIG_CMD_GPT_RENAME=y
CONFIG_CMD_LSBLK=y
CONFIG_CMD_MMC=y
CONFIG_CMD_MMC_SWRITE=y
CONFIG_CMD_MTD=y
CONFIG_CMD_NAND=y
CONFIG_CMD_PART=y
CONFIG_CMD_PCI=y
CONFIG_CMD_POWEROFF=y
CONFIG_CMD_READ=y
CONFIG_CMD_SPI=y
CONFIG_CMD_USB=y
CONFIG_CMD_USB_MASS_STORAGE=y
CONFIG_CMD_BLOCK=y
CONFIG_CMD_SETEXPR_FMT=y
CONFIG_CMD_DHCP=y
CONFIG_BOOTP_MAY_FAIL=y
CONFIG_BOOTP_DNS2=y
CONFIG_BOOTP_PREFER_SERVERIP=y
CONFIG_BOOTP_NISDOMAIN=y
CONFIG_BOOTP_NTPSERVER=y
CONFIG_CMD_PCAP=y
CONFIG_CMD_TFTPPUT=y
# CONFIG_CMD_NFS is not set
CONFIG_CMD_MII=y
CONFIG_CMD_PING=y
CONFIG_CMD_DNS=y
CONFIG_CMD_BOOTCOUNT=y
CONFIG_CMD_CACHE=y
CONFIG_CMD_EXCEPTION=y
CONFIG_CMD_TIME=y
CONFIG_CMD_GETTIME=y
CONFIG_CMD_TIMER=y
CONFIG_CMD_SYSBOOT=y
CONFIG_CMD_EXT2=y
CONFIG_CMD_EXT4=y
CONFIG_CMD_EXT4_WRITE=y
CONFIG_CMD_FAT=y
CONFIG_CMD_FS_GENERIC=y
CONFIG_CMD_MTDPARTS=y
CONFIG_CMD_MTDPARTS_SPREAD=y
CONFIG_CMD_MTDPARTS_SHOW_NET_SIZES=y
CONFIG_CMD_AVB=y
CONFIG_MMC_SPEED_MODE_SET=y
CONFIG_PARTITION_TYPE_GUID=y
CONFIG_SPL_OF_CONTROL=y
CONFIG_OF_BOARD=y
CONFIG_OF_SPL_REMOVE_PROPS="pinctrl-0 pinctrl-names clocks clock-names interrupt-parent interrupts"
CONFIG_NET_RETRY_COUNT=20
CONFIG_NET_RANDOM_ETHADDR=y
CONFIG_KEEP_SERVERADDR=y
CONFIG_BOOTP_SERVERIP=y
CONFIG_SPL_DM=y
CONFIG_SPL_DM_WARN=y
CONFIG_SPL_DM_SEQ_ALIAS=y
CONFIG_REGMAP=y
CONFIG_SPL_REGMAP=y
CONFIG_SYSCON=y
CONFIG_SPL_SYSCON=y
CONFIG_SIMPLE_BUS_CORRECT_RANGE=y
CONFIG_SPL_OF_TRANSLATE=y
CONFIG_SPL_BLOCK_CACHE=y
CONFIG_BOOTCOUNT_LIMIT=y
CONFIG_DM_BOOTCOUNT=y
CONFIG_CLK=y
CONFIG_SPL_CLK=y
CONFIG_CLK_AXERA=y
CONFIG_LUA_PLL_FIXED_FREQ=y
CONFIG_DFU_MMC=y
CONFIG_UDP_FUNCTION_FASTBOOT=y
CONFIG_FASTBOOT_BUF_ADDR=0x3090000000
CONFIG_FASTBOOT_BUF_SIZE=0x10000000
CONFIG_FASTBOOT_FLASH=y
CONFIG_FASTBOOT_FLASH_MMC_DEV=1
CONFIG_DWAPB_GPIO=y
# CONFIG_I2C is not set
# CONFIG_INPUT is not set
CONFIG_DM_MAILBOX=y
CONFIG_MISC=y
# CONFIG_MMC_QUIRKS is not set
CONFIG_SUPPORT_EMMC_RPMB=y
CONFIG_SUPPORT_EMMC_BOOT=y
CONFIG_MMC_HS200_SUPPORT=y
CONFIG_MMC_SDHCI=y
CONFIG_MMC_SDHCI_ADMA=y
CONFIG_MMC_SDHCI_LMT=y
CONFIG_MTD=y
CONFIG_DM_MTD=y
CONFIG_SYS_MTDPARTS_RUNTIME=y
CONFIG_MTD_RAW_NAND=y
CONFIG_MTD_SPI_NAND=y
CONFIG_DM_SPI_FLASH=y
CONFIG_SPI_FLASH_STMICRO=y
CONFIG_SPI_FLASH_MT35XU=y
CONFIG_SPI_FLASH_SST=y
CONFIG_SPI_FLASH_MTD=y
CONFIG_DM_MTD_SPI_NOR=y
CONFIG_SPL_DM_MTD_SPI_NOR=y
CONFIG_DM_MDIO=y
CONFIG_DM_ETH_PHY=y
CONFIG_PHY_GIGE=y
CONFIG_DWC_ETH_QOS=y
CONFIG_DWC_ETH_QOS_LUA=y
CONFIG_E1000=y
CONFIG_CMD_E1000=y
CONFIG_PCI=y
CONFIG_PCIE_ECAM_GENERIC=y
CONFIG_PCI_ENDPOINT=y
CONFIG_PINCTRL=y
CONFIG_PINCONF=y
# CONFIG_POWER is not set
CONFIG_DM_REBOOT_MODE=y
CONFIG_BOOT_DEVICE=y
CONFIG_SPL_BOOT_DEVICE=y
CONFIG_DM_RESET=y
CONFIG_RESET_SYSCON=y
CONFIG_BAUDRATE=921600
CONFIG_SPECIFY_CONSOLE_INDEX=y
CONFIG_CONS_INDEX=2
CONFIG_SERIAL_RX_BUFFER=y
CONFIG_SERIAL_SEARCH_ALL=y
CONFIG_SERIAL_PROBE_ALL=y
CONFIG_DEBUG_UART_SHIFT=2
CONFIG_SYS_NS16550=y
CONFIG_SOC_LAGUNA=y
CONFIG_DM_GLBCON=y
CONFIG_FDL_UART=y
CONFIG_FDL_USB=y
CONFIG_FDL_DEBUG=y
CONFIG_FDL_USB_DRV=y
CONFIG_SPI=y
CONFIG_DM_SPI=y
CONFIG_DESIGNWARE_SPI=y
CONFIG_PL022_SPI=y
CONFIG_SYSINFO=y
CONFIG_SPL_SYSINFO=y
CONFIG_SYSINFO_SYSCON=y
CONFIG_USB=y
# CONFIG_SPL_DM_USB is not set
CONFIG_USB_XHCI_HCD=y
CONFIG_USB_DWC3=y
CONFIG_USB_DWC3_GENERIC=y
CONFIG_USB_STORAGE=y
CONFIG_USB_GADGET=y
CONFIG_USB_GADGET_DOWNLOAD=y
CONFIG_VIRTIO_MMIO=y
CONFIG_VIRTIO_PCI=y
CONFIG_VIRTIO_NET=y
CONFIG_VIRTIO_BLK=y
CONFIG_CC_OPTIMIZE_LIBS_FOR_SPEED=y
# CONFIG_SPL_USE_TINY_PRINTF is not set
CONFIG_SPL_TINY_MEMSET=y
CONFIG_LIBAVB=y
CONFIG_SHA384=y
# CONFIG_VPL_LZMA is not set
CONFIG_SPL_GZIP=y
CONFIG_HEXDUMP=y
CONFIG_SPL_HEXDUMP=y
CONFIG_GETOPT=y
CONFIG_FDT_FIXUP_PARTITIONS=y
# CONFIG_EFI_LOADER is not set
CONFIG_UNIT_TEST=y
CONFIG_SPL_UNIT_TEST=y
# CONFIG_UT_LIB_ASN1 is not set
# CONFIG_UT_LOG is not set
# CONFIG_UT_UNICODE is not set
# CONFIG_UT_ENV is not set
# CONFIG_UT_OVERLAY is not set
```
