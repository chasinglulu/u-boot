## configs/lua-zebu_defconfig
```kconfig
CONFIG_ARM=y
# CONFIG_ARM64_CRC32 is not set
CONFIG_POSITION_INDEPENDENT=y
CONFIG_SYS_INIT_SP_BSS_OFFSET=262144
# CONFIG_ARM64_SUPPORT_AARCH32 is not set
CONFIG_ARCH_AXERA=y
CONFIG_SYS_MALLOC_LEN=0x800000
CONFIG_SPL_LIBCOMMON_SUPPORT=y
CONFIG_SPL_LIBGENERIC_SUPPORT=y
CONFIG_NR_DRAM_BANKS=1
CONFIG_DEFAULT_DEVICE_TREE="laguna-zebu"
CONFIG_SPL_TEXT_BASE=0x14000000
CONFIG_SYS_PROMPT="LUA$ "
CONFIG_SPL_SERIAL=y
CONFIG_SPL_SIZE_LIMIT=0x200000
CONFIG_SPL_SIZE_LIMIT_PROVIDE_STACK=0x10000
CONFIG_DEBUG_UART_BASE=0x0E403000
CONFIG_DEBUG_UART_CLOCK=10000000
# CONFIG_PSCI_RESET is not set
CONFIG_AXERA_LUA=y
CONFIG_TARGET_LUA_ZEBU=y
CONFIG_LUA_SAFETY_INIT=y
CONFIG_LUA_R5F_DEMO_CV=y
CONFIG_SYS_LOAD_ADDR=0x0
CONFIG_DEBUG_UART=y
CONFIG_CC_OPTIMIZE_FOR_SPEED=y
CONFIG_ENV_VARS_UBOOT_CONFIG=y
# CONFIG_EXPERT is not set
# CONFIG_LEGACY_IMAGE_FORMAT is not set
# CONFIG_ARCH_FIXUP_FDT_MEMORY is not set
# CONFIG_AUTOBOOT is not set
CONFIG_USE_BOOTCOMMAND=y
CONFIG_BOOTCOMMAND="run distro_bootcmd"
CONFIG_CONSOLE_RECORD=y
CONFIG_SYS_CONSOLE_IS_IN_ENV=y
# CONFIG_DISPLAY_BOARDINFO is not set
CONFIG_BOARD_LATE_INIT=y
CONFIG_STACKPROTECTOR=y
CONFIG_SPL_FRAMEWORK_BOARD_INIT_F=y
CONFIG_SPL_MAX_SIZE=0x1FE000
CONFIG_SPL_PAD_TO=0x0
CONFIG_SPL_HAS_BSS_LINKER_SECTION=y
CONFIG_SPL_BSS_START_ADDR=0x141C0000
CONFIG_SPL_BSS_MAX_SIZE=0x2000
# CONFIG_SPL_RAW_IMAGE_SUPPORT is not set
# CONFIG_SPL_LEGACY_IMAGE_FORMAT is not set
CONFIG_SPL_SYS_MALLOC_SIMPLE=y
# CONFIG_SPL_SEPARATE_BSS is not set
CONFIG_SPL_DISPLAY_PRINT=y
CONFIG_HUSH_PARSER=y
# CONFIG_CMDLINE_EDITING is not set
# CONFIG_CMD_BDI is not set
# CONFIG_CMD_CONSOLE is not set
# CONFIG_CMD_BOOTD is not set
# CONFIG_CMD_BOOTM is not set
# CONFIG_CMD_BOOTI is not set
# CONFIG_CMD_ELF is not set
# CONFIG_CMD_GO is not set
# CONFIG_CMD_RUN is not set
# CONFIG_CMD_IMI is not set
# CONFIG_CMD_XIMG is not set
# CONFIG_CMD_EXPORTENV is not set
# CONFIG_CMD_IMPORTENV is not set
# CONFIG_CMD_EDITENV is not set
# CONFIG_CMD_ENV_EXISTS is not set
CONFIG_CMD_NVEDIT_LOAD=y
# CONFIG_CMD_CRC32 is not set
CONFIG_CMD_STRINGS=y
CONFIG_CMD_DM=y
# CONFIG_CMD_LOADB is not set
# CONFIG_CMD_LOADS is not set
# CONFIG_CMD_ECHO is not set
# CONFIG_CMD_ITEST is not set
# CONFIG_CMD_SOURCE is not set
# CONFIG_CMD_SETEXPR is not set
# CONFIG_CMD_SLEEP is not set
CONFIG_SPL_OF_CONTROL=y
CONFIG_OF_BOARD=y
# CONFIG_NET is not set
CONFIG_SPL_DM=y
# CONFIG_DM_DEVICE_REMOVE is not set
# CONFIG_SIMPLE_BUS is not set
# CONFIG_SPL_SIMPLE_BUS is not set
# CONFIG_OF_TRANSLATE is not set
# CONFIG_GPIO is not set
# CONFIG_I2C is not set
# CONFIG_INPUT is not set
# CONFIG_MMC is not set
# CONFIG_POWER is not set
CONFIG_SPECIFY_CONSOLE_INDEX=y
CONFIG_SERIAL_RX_BUFFER=y
CONFIG_SERIAL_SEARCH_ALL=y
CONFIG_SERIAL_PROBE_ALL=y
CONFIG_DEBUG_UART_SHIFT=2
CONFIG_DEBUG_UART_ANNOUNCE=y
CONFIG_SYS_NS16550=y
CONFIG_DW_UART_INIT=y
CONFIG_CC_OPTIMIZE_LIBS_FOR_SPEED=y
# CONFIG_SPL_USE_TINY_PRINTF is not set
CONFIG_AES=y
CONFIG_SHA1=y
CONFIG_SHA256=y
CONFIG_SHA384=y
CONFIG_MD5=y
# CONFIG_GZIP is not set
CONFIG_UNIT_TEST=y
# CONFIG_UT_LIB_ASN1 is not set
# CONFIG_UT_LOG is not set
# CONFIG_UT_UNICODE is not set
# CONFIG_UT_ENV is not set
# CONFIG_UT_OVERLAY is not set
```

## configs/x4412_defconfig
```kconfig
CONFIG_ARM=y
CONFIG_ARCH_EXYNOS=y
CONFIG_SYS_TEXT_BASE=0x43E00000
CONFIG_ARCH_EXYNOS4=y
CONFIG_TARGET_X4412=y
CONFIG_SPL=y
CONFIG_SPL_TEXT_BASE=0x02025000
# CONFIG_SPL_FRAMEWORK is not set
CONFIG_IDENT_STRING=" for X4412"
CONFIG_DEFAULT_DEVICE_TREE="exynos4412-x4412"
CONFIG_SYS_PROMPT="X4412 # "
# CONFIG_CMD_XIMG is not set
CONFIG_DISTRO_DEFAULTS=y
# CONFIG_USE_BOOTCOMMAND is not set
# CONFIG_CMD_IMLS is not set
# CONFIG_CMD_FPGA is not set
# CONFIG_CMD_NFS is not set
# CONFIG_CMD_MISC is not set
# CONFIG_SYS_THUMB_BUILD is not set
CONFIG_SPL_SERIAL_SUPPORT=y
CONFIG_SPL_GPIO_SUPPORT=y
CONFIG_DEBUG_UART=y
CONFIG_DEBUG_UART_BASE=0x13830000
CONFIG_DEBUG_UART_CLOCK=100000000
CONFIG_S5P=y
CONFIG_DEBUG_UART_S5P=y
CONFIG_DEBUG_UART_ANNOUNCE=y
CONFIG_CMD_MMC=y
CONFIG_DM_MMC=y
CONFIG_MMC_DW=y
CONFIG_MMC_SDHCI=y
CONFIG_MMC_SDHCI_SDMA=y
CONFIG_MMC_SDHCI_S5P=y
CONFIG_CMD_USB=y
CONFIG_CMD_GPIO=y
CONFIG_USB=y
CONFIG_DM_USB=y
CONFIG_PINCTRL=y
CONFIG_PINCTRL_GENERIC=y
CONFIG_PINCTRL_EXYNOS=y
CONFIG_PINCTRL_EXYNOS4412=y
```

## drivers/boot-device/Kconfig
```kconfig
#
# SPDX-License-Identifier: GPL-2.0+
#
# Copyright (C) 2024 Charleye <wangkart@aliyun.com>
#

menu "Boot Device Support"

config DM_BOOT_DEVICE
	bool "Enable boot device using Driver Model"
	depends on DM
	help
	  Enable support for boot device control. This will allow users to
	  adjust the boot process based on boot device parameter
	  passed to U-Boot.

config DM_BOOT_DEVICE_GPIO
	bool "Use GPIOs as boot device backend"
	depends on DM_BOOT_DEVICE
	help
	  Use GPIOs to control the boot device. This will allow users to boot
	  a chip from a specific device by using a GPIO that can be controlled
	  outside U-Boot.

endmenu
```

## drivers/bootdev/Kconfig
```kconfig
#
# SPDX-License-Identifier: GPL-2.0+
#
# Copyright (C) 2024 Charleye <wangkart@aliyun.com>
#

menu "Boot Device Support"

config BOOT_DEVICE
	bool "Enable boot device using Driver Model"
	depends on DM
	help
	  Enable support for boot device control. This will allow users to
	  adjust the boot process based on boot device parameter passed
	  to U-Boot.

choice
	prompt "Select boot device backend"
	depends on BOOT_DEVICE
	default BOOT_DEVICE_SYSCON

config BOOT_DEVICE_GPIO
	bool "Use GPIOs as boot device backend"
	depends on DM_GPIO
	help
	  Use GPIOs to control the boot device. This will allow users to boot
	  a chip from a specific device by using a GPIO that can be controlled
	  outside U-Boot.

config BOOT_DEVICE_SYSCON
	bool "Use syscon as boot device backend"
	depends on SYSCON
	help
	  Use syscon to control the boot device. This will allow users to boot
	  a chip from a specific device by using syscon that can be controlled
	  outside U-Boot.

config BOOT_DEVICE_NONE
	bool "none boot device backend"
	help
	  Use none to make compilation pass

endchoice


config SPL_BOOT_DEVICE
	bool "Enable boot device in SPL"
	depends on SPL_DM
	help
	  Enable support for boot device control. This will allow users to
	  adjust the boot process based on boot device parameter passed
	  to SPL.

choice
	prompt "Select boot device backend in SPL"
	depends on SPL_BOOT_DEVICE
	default SPL_BOOT_DEVICE_SYSCON

config SPL_BOOT_DEVICE_GPIO
	bool "Use GPIOs as boot device backend in SPL"
	depends on SPL_GPIO
	help
	  Use GPIOs to control the boot device. This will allow users to boot
	  a chip from a specific device by using a GPIO that can be controlled
	  outside SPL.

config SPL_BOOT_DEVICE_SYSCON
	bool "Use syscon as boot device backend in SPL"
	depends on SPL_SYSCON && SPL_REGMAP
	help
	  Use syscon to control the boot device. This will allow users to boot
	  a chip from a specific device by using syscon that can be controlled
	  outside SPL.

config SPL_BOOT_DEVICE_NONE
	bool "none boot device backend in SPL"
	help
	  Use none to make compilation pass in SPL

endchoice

endmenu
```

## drivers/clk/axera/Kconfig
```kconfig
# SPDX-License-Identifier: GPL-2.0+
#
# Copyright (C) 2024 Charleye <wangkart@aliyun.com>
#

config CLK_AXERA
	bool "Clock support for Axera SoC family of devices"
	depends on CLK
	help
	  Enables the clock translation layer from DT to device clocks.

choice
	prompt "Axera Clock Driver Version"
	depends on CLK_AXERA
	default CLK_AXERA_V2

config CLK_AXERA_V1
	depends on CLK_CCF
	bool "V1"

config CLK_AXERA_V2
	depends on !CLK_CCF
	bool "V2"

endchoice

config LUA_PLL_FIXED_FREQ
	bool "Fixed PLL Clock Frequency"
	depends on CLK_AXERA
	help
	  This option enables support for fixed PLL frequency.

config LUA_PLL_SET_RATE
	bool "Allow PLL Frequency Setting"
	depends on CLK_AXERA
	help
	  This option allows seting PLL frequency.

config SPL_CLK_AXERA
	bool "Clock support for Axera SoC family of devices in SPL"
	depends on CLK && SPL
	help
	  Enables the clock translation layer from DT to device clocks.
```

## drivers/soc/axera/Kconfig
```kconfig
# SPDX-License-Identifier: GPL-2.0+

menuconfig SOC_LAGUNA
	bool "Laguna SoC drivers support"
	depends on LUA_SOC

if SOC_LAGUNA

config DM_GLBCON
	bool "Support Subsystem Global Control Register Driver"
	depends on DM
	help
	  This option support sysctl driver for Global Register Controller.

source "drivers/soc/axera/fdl/Kconfig"

config FDL_USB_DRV
	bool "Enable USB Driver support only for FDL"
	depends on DM
	help
	  Enable USB raw read/write function.

config SPL_FDL_USB_DRV
	bool "Enable USB Driver support only for FDL in SPL"
	depends on SPL_DM
	help
	  Enable USB raw read/write function in SPL.

config ABORT_ALARM
	bool "Enable Abort Alarm Support"
	depends on DM
	help
	  This option support abort alarm in U-Boot

config SPL_ABORT_ALARM
	bool "Enable Abort Alarm Support in SPL"
	depends on SPL_DM
	help
	  This option support abort alarm in SPL

config ABC_SYSCON
	bool "Support ABC SYSCON Driver"
	depends on DM
	help
	  This option support syscon driver for AB Control.

config SPL_ABC_SYSCON
	bool "Support ABC SYSCON in SPL"
	depends on SPL_DM
	help
	  This option support syscon driver for AB Control in SPL

endif
```

## drivers/soc/axera/fdl/Kconfig
```kconfig
menu "FDL Support"

config FDL_UART
	bool "Enable FDL download over UART"
	depends on DM_SERIAL
	select FDL

config FDL_USB
	bool "Enable FDL download over USB"
	depends on FDL_USB_DRV
	select FDL

config FDL_SDCARD
	bool "Enable FDL download over SDCard"
	depends on DM_MMC
	select FDL

config FDL
	bool

if FDL

config FDL_TIMEOUT
	int "FDL timeout (ms)"
	default 10000
	help
	  This specifies the timeout for receiving FDL command packets
	  and image data.

config FDL_BUF_ADDR
	hex "Define FDL buffer address"
	default 0x108800000 if AXERA_LUA
	help
	  The FDL protocol requires a large memory buffer for
	  downloads. Define this to the starting RAM address to use for
	  downloaded images.

config FDL_BUF_SIZE
	hex "Define FDL buffer size"
	default 0x6000000 if AXERA_LUA
	help
	  The FDL protocol requires a large memory buffer for
	  downloads. This buffer should be as large as possible for a
	  platform. Define this to the size available RAM for FDL.

config FDL_PARTITION_IMAGE
	string "FDL Partition Table Image Filename"
	depends on FDL_SDCARD
	default "fdl_partition.img"
	help
	  This specifies the filename of the FDL partition table image
	  to be used for FDL download over SDCard. The image should
	  contain the partition table.

config FDL_IMAGE_SUFFIX
	string "FDL Image File Suffix"
	depends on FDL_SDCARD
	default ".img"
	help
	  This specifies the suffix of the FDL image files. The FDL
	  download command will look for files with this suffix in the
	  FDL download directory. For example, if the suffix is ".img",
	  the FDL download command will look for files like
	  "u-boot.img", "kernel.img", etc.

config FDL_SHA1SUM
	bool "Enable SHA1 checksum verification"
	depends on FDL_SDCARD
	select SHA1
	help
	  This enables SHA1 checksum verification for FDL
	  downloaded images over SDCard. If enabled, the FDL download
	  command will verify the SHA1 checksum of the downloaded image
	  against the expected checksum before proceeding with the
	  download.

config FDL_SHA1SUM_FILENAME
	string "SHA1 checksum filename"
	depends on FDL_SDCARD && FDL_SHA1SUM
	default "sha1sum.txt"
	help
	  This specifies the filename of the SHA1 checksum file to be
	  used for FDL download over SDCard. The file should contain
	  the SHA1 checksums of the FDL images in the format:
	  "<sha1sum> <filename>". For example:
	  "1234567890abcdef1234567890abcdef12345678 u-boot.img".

config FDL_DEBUG
	bool "FDL debug"
	help
	  This enables the FDL debug mode. If unsure, say N.

config FDL_VERBOSE
	bool "Output more information about the FDL"
	help
	  Enable the output of more information about the FDL
	  such as the command operation state.

choice
	prompt "FDL Protocol Select"
	default FDL_FDL2_PROTO
	depends on !FDL_DEBUG

config FDL_ROMCODE_PROTO
	bool "ROMCode protocol"
	help
	  This enables the FDL ROMCode protocol.

config FDL_FDL1_PROTO
	bool "FDL1 protocol"
	help
	  This enables the FDL FDL1 protocol.

config FDL_FDL2_PROTO
	bool "FDL2 protocol"
	help
	  This enables the FDL FDL2 protocol.

endchoice

choice
	prompt "FDL Data Packet Type"
	default FDL_RAW_DATA_DL

config FDL_PACKAGE_DATA_DL
	bool "Package Data download"

config FDL_RAW_DATA_DL
	bool "Raw Data download"

endchoice

endif

endmenu
```
