## arch/arm/mach-axera-r5f/Kconfig
```kconfig
# SPDX-License-Identifier: GPL-2.0

if ARCH_AXERA_R5F

choice
	prompt "Safety Island Platform Select"

config TARGET_LUA_R5F_VIRT
	bool "Laguna R5F Based Qemu Virtual Platform"
	select LUA_R5F
	help
	  lua-safety-virt is a virtual development platform for Safety Island on QEMU,
	  with a few part of function and physical connectors support
	  like UART, ETH, TIMER, GPIO, I2C...

config TARGET_LUA_R5F_FPGA
	bool "Laguna R5F Based FPGA Verification Paltform"
	select LUA_R5F
	help
	  FPGA is a verification board for Axera Laguna Safety Island,
	  with a little function and physical connectors support like UART,
	  JTAG, eMMC, ETH...

endchoice

config LUA_R5F
	bool

menu "Safety Island Features"
	depends on LUA_R5F

config CPU_FREQ_HZ
	int "CPU frequency"
	depends on LUA_R5F
	default 800000000
	help
	  The value, in Hz, that the CPU clock is running at.

menu "MTD Settings"
source "board/axera/common/laguna_r5f/Kconfig"
endmenu

endmenu

config SYS_VENDOR
	default "axera"

config SYS_SOC
	default "axera-r5f"

config SYS_CONFIG_NAME
	default "laguna_r5f"
	help
	  This option contains information about board configuration name.
	  Based on this option include/configs/<CONFIG_SYS_CONFIG_NAME>.h header
	  will be used for board configuration.

config SYS_MALLOC_F_LEN
	default 0x600

source "board/axera/qemu-virt/laguna_r5f/Kconfig"
source "board/axera/fpga/laguna_r5f/Kconfig"

endif
```

## arch/arm/mach-axera/Kconfig
```kconfig
if ARCH_AXERA

config AXERA_LMT
	bool "Support Lambert SoC"
	select ARM64
	select DM_ETH
	select SUPPORT_SPL
	select SPL
	help
	  The Lambert SoC is a ARM-based SoC with a eight-core Cortex-A76
	  and dual-core NPU.
	  including 2M SRAM, 128K L2 cache per core, 2M L3 cache, dual-core
	  lockstep RISC-V and DSP, two DDR5 controller and video codec support.
	  Peripherals include Gigabit Ethernet, MIPI, PCIe, eMMC, I2S, UARTs, SPI,
	  I2C and PWMs.

config AXERA_LUA
	bool "Support Laguna SoC"
	select ARM64
	select SPL
	select SUPPORT_SPL
	select SYS_MALLOC_F
	help
	  The Laguna SoC is a ARM-based SoC with a quad-core Cortex-A55
	  and dual-core NPU. including 2M SRAM, 128K L2 cache per core,
	  2M L3 cache, dual-core lockstep Cortex-R5f, two DDR5 controller
	  and video codec support. Peripherals include Gigabit Ethernet,
	  MIPI, eMMC, I2S, UARTs, SPI, I2C and PWMs.

source "arch/arm/mach-axera/lambert/Kconfig"
source "arch/arm/mach-axera/laguna/Kconfig"

endif
```

## arch/arm/mach-axera/laguna/Kconfig
```kconfig
if AXERA_LUA

choice
	prompt "Axera Luguna SoC board select"

config TARGET_LUA_DVB
	bool "Laguna SoC Development Verification board"
	select LUA_SOC
	help
	  Laguna DVB is a development board for Axera Laguna SoC,
	  with full function and physical connectors support like MIPI,
	  JTAG, MAC, SD card, CAN, QSPI, USB-to-serial...

config TARGET_LUA_VIRT
	bool "Laguna Virtual Qemu Development board"
	select LUA_SOC
	help
	  lmt-virt is a virtual development board for Axera Laguna SoC based on QEMU,
	  with a few part of function and physical connectors support
	  like eMMC, MAC, SDIO, GPIO, I2C...

config TARGET_LUA_FPGA
	bool "Laguna FPGA Verification board"
	select LUA_SOC
	help
	  FPGA is a verification board for Axera Laguna SoC,
	  with a little function and physical connectors support like UART,
	  JTAG, eMMC, USB-to-serial...

config TARGET_LUA_ZEBU
	bool "Laguna ZeBu Verification Platform"
	select LUA_SOC
	help
	  ZeBu is a verification platform for Axera Laguna SoC.

endchoice

config LUA_SOC
	bool

config SYS_MALLOC_F_LEN
	default 0x4000

menu "Laguna SoC features"
	depends on LUA_SOC

config LUA_DRAM_BASE
	hex "Laguna DRAM Base Address"
	default 0x100000000

config LUA_IRAM_BASE
	hex "Laguna IRAM Base Address"
	default 0x00400000

config LUA_OCM_BASE
	hex "Laguna NPU OCM Base Address"
	default 0x14000000

menu "Bootflow Settings"

config LUA_ATF_SUPPORT
	bool "Enable Arm Trusted Firmware support"
	help
	  This option enables Arm Trusted Firmware support.

config LUA_OPTEE_SUPPORT
	bool "Enable OP-TEE support"
	help
	  This option enables OP-TEE support.

endmenu

menu "SPL Loading Images"
	depends on SPL

config LUA_SPL_ATF_LOAD_ADDR
	hex "ATF firmware loaded address"
	depends on LUA_ATF_SUPPORT
	default 0x100104000

config LUA_SPL_ATF_LOAD_SIZE
	hex "ATF firmware loaded size"
	depends on LUA_ATF_SUPPORT
	default 0x200000

config LUA_SPL_OPTEE_LOAD_ADDR
	hex "OP-TEE firmware loaded address"
	depends on LUA_OPTEE_SUPPORT
	default 0x104000000

config LUA_SPL_OPTEE_LOAD_SIZE
	hex "OP-TEE firmware loaded size"
	depends on LUA_OPTEE_SUPPORT
	default 0x2000000

config LUA_SPL_UBOOT_LOAD_ADDR
	hex "U-Boot firmware loaded address"
	default 0x100200000

config LUA_SPL_UBOOT_LOAD_SIZE
	hex "U-Boot firmware loaded size"
	default 0x400000

endmenu

menu "U-Boot Loading Images"
config LUA_SCRIPT_LOAD_ADDR
	hex "Boot script load address"
	default 0x10f000000

config LUA_KERNEL_LOAD_NAME
	string "Kernel image name"
	default Image

config LUA_KERNEL_LOAD_ADDR
	hex "Kernel image loaded address"
	default 0x110000000

config LUA_KERNEL_COMP_ADDR
	hex "Kernel image decompression address"
	default 0x120000000

config LUA_KERNEL_COMP_SIZE
	hex "Kernel image decompression buffer size"
	default 0x04000000

config LUA_FDT_LOAD_NAME
	string "FDT image name"
	default "laguna.dtb"

config LUA_FDT_LOAD_ADDR
	hex "DTB image loaded address"
	default 0x118000000

config LUA_RAMDISK_LOAD_NAME
	string "initramfs image name"
	default "rootfs.cpio.gz"

config LUA_RAMDISK_LOAD_ADDR
	hex "initramfs image loaded address"
	default 0x119000000

endmenu

menu "Processor Specific Low-level Init"
config LUA_SWITCH_TO_EL2
	bool "Force Switch to EL2"
	help
	  This option is used to switch CPU into EL2 state. When verifying on the FPGA,
	  there is no BL31 environment, and the CPU cannot directly enter the EL2 state,
	  so it is necessary to switch the CPU to the EL2 state when U-boot starts executing.

config LUA_GICV2_LOWLEVEL_INIT
	bool "Enable GICv2"
	select GICV2
	help
	  This option enables GIC-400. When running on an FPGA alone,
	  we can initialize GIC without BL31, configure security related settings,
	  and complete the same initialization configuration of GIC as BL31.

config LUA_GICD_BASE
	hex "GIC Distributor Base"
	depends on LUA_GICV2_LOWLEVEL_INIT
	default 0x08001000

config LUA_GICC_BASE
	hex "GIC CPU Interfaces Base"
	depends on LUA_GICV2_LOWLEVEL_INIT
	default 0x08002000

config LUA_GTMR_LOWLEVEL_INIT
	bool "Enable Generic Timer Counter"
	help
	  This option enables GTMR_CNT.

config LUA_MAIN_SEC_GLB_BASE
	hex "Main Domain Secure Global Base (sec_glb)"
	depends on LUA_GTMR_LOWLEVEL_INIT
	default 0x18000000

config LUA_GTMR_CNT_OFFSET
	hex "GTMR_CNT Control Offset from sec_glb"
	depends on LUA_GTMR_LOWLEVEL_INIT
	default 0x1D4

config LUA_CPU_GTMR_CNT_BASE
	hex "Generic Timer System Counter Control Base"
	depends on LUA_GTMR_LOWLEVEL_INIT
	default 0x08012000

config LUA_PERIPH_CRU
	bool "Enable Periph Subsystem Clock Gate & Reset"
	help
	  This option enables periph subsystem clock gate and
	  reset sysctl register.

config LUA_PERIPH_CRU_BASE
	hex "Periph Clock & Reset Base"
	depends on LUA_PERIPH_CRU
	default 0x0E001000

config LUA_PERIPH_CLK_GATE_REG0
	hex "Periph Global Clock Gate Enable Register 0"
	depends on LUA_PERIPH_CRU
	default 0x40

config LUA_PERIPH_SWRST_REG0
	hex "Periph Software Control Reset Register 0"
	depends on LUA_PERIPH_CRU
	default 0x120

config LUA_SAFETY_INIT
	bool "Initialize Safety Peripherals"
	help
	  This option enables initialization of safety domain peripherals,
	  like UART, Ethernet...

config LUA_DSU_PMU_INIT
	bool "Enable DSU PMU Register Access"
	help
	  This option enable DSU PMU registers write-accessible from EL1 non-secure.

config LUA_RAS_INIT
	bool "Enable Error Record Registers Access"
	help
	  This option enable RAS error record registers write-accessible
	  from non-secure or secure EL1 and EL2.

endmenu

menu "Secure Boot Settings"

config LUA_SECURE_BOOT
	bool "Enable secure boot support"
	help
	  This option enables secure boot support.

config LUA_FIT
	bool "Enable FIT configuration"
	help
	  This option enables FIT related configuration.

config SPL_LOAD_MULTI_FIT
	bool "Support for multi-FIT images loaded by SPL"
	depends on LUA_FIT
	default y
	help
	  This option enable support for multi-FIT images
	  loaded by SPL.

choice
	prompt "Hashing Algorithm Select"
	depends on LUA_SECURE_BOOT
	default LUA_SHA256

config LUA_SHA256
	bool "SHA256"
	select SHA256
	select SPL_SHA256 if SPL
	help
	  This option uses SHA512 algorithm for hasing.

config LUA_SHA384
	bool "SHA384"
	select SHA384
	select SPL_SHA384 if SPL
	help
	  This option uses SHA384 algorithm for hasing.

config LUA_SHA512
	bool "SHA512"
	select SHA512
	select SPL_SHA512 if SPL
	help
	  This option uses SHA512 algorithm for hasing.

endchoice

config LUA_RAS
	bool "Enable RSA Verifacation"
	depends on LUA_SECURE_BOOT
	select RSA
	select RSA_VERIFY
	select SPL_RSA if SPL
	select SPL_RSA_VERIFY if SPL

choice
	prompt "RSA Algorithm Select"
	depends on LUA_RAS
	default LUA_RSA2048

config LUA_RSA2048
	bool "RSA-2048"
	help
	  This option uses RSA-2048 algorithm for Signature & Verification.

config LUA_RSA3072
	bool "RSA-3072"
	help
	  This option uses RSA-3072 algorithm for Signature & Verification.

config LUA_RSA4096
	bool "RSA-4096"
	help
	  This option uses RSA-4096 algorithm for Signature & Verification.

endchoice

config LUA_PKEY_CHOICE
	bool "Choose the location for the public key"
	depends on LUA_SECURE_BOOT
	default y
	help
	  RSA verification can use pre-calculated public key parameter
	  which are stored in fdt blob, or use public key which are stored
	  in code, in decrypting a signature.

	  The standard RSA-signature verification code (FIT_SIGNATURE) uses
	  key parameter.

	  If unsure, say no.

choice
	prompt "Public Key Location"
	depends on LUA_PKEY_CHOICE
	default LUA_PKEY_FDT

config LUA_PKEY_FDT
	bool "Public Key stored in FDT blob"
	help
	  Public Key Parameter (N & E) is stored in FDT blob.

config LUA_PKEY_CODE
	bool "Public Key stored in code"
	help
	  Public Key (DER) is stored in Code.

endchoice

endmenu

menu "MTD Settings"
source "board/axera/common/laguna/Kconfig"
endmenu

menu "FDL-specific Settings"

config FDL_FLASH_MMC_DEV
	int "Define FDL MMC FLASH default device"
	depends on DM_MMC
	default 0
	help
	  The FDL flash command requires additional information
	  regarding the non-volatile storage device. Define this to
	  the eMMC device that FDL should use to store the image.

config FDL_FLASH_NOR_MTD_DEV
	int "Define FDL NOR MTD FLASH default device"
	depends on DM_MTD
	default 0
	help
	  The FDL flash command requires additional information
	  regarding the non-volatile storage device. Define this to
	  the NOR MTD device that FDL should use to store the image.

config FDL_FLASH_NAND_MTD_DEV
	int "Define FDL NAND MTD FLASH default device"
	depends on DM_MTD
	default 1
	help
	  The FDL flash command requires additional information
	  regarding the non-volatile storage device. Define this to
	  the NAND MTD device that FDL should use to store the image.

endmenu

menu "Misc Settings"

config LUA_AB
	bool "A/B Support"
	select ANDROID_AB
	select CMD_AB_SELECT
	select CMD_ABC
	help
	  AVB has been designed to work with A/B by requiring that
	  the A/B suffix is never used in any partition names stored
	  in descriptors.

config LUA_R5F_DEMO_CV
	bool "Load R5F Demo for CV"
	help
	  This option is used to enable function that load R5F
	  demo for CV verification.

config LUA_R5F_CPU_RELEASE_ADDR
	hex "R5F cpu release address"
	default 0x6C4054
	depends on LUA_R5F_DEMO_CV
	help
	  This enable r5f cpu to exit loop and start the demo.

config LUA_CUSTOM_SERVERIP
	bool "Custom severip"
	help
	  This option enable us to specify a server IP address
	  used for tftpboot.

config LUA_SERVERIP
	depends on LUA_CUSTOM_SERVERIP
	string "serverip used for tftpboot"
	default 10.0.2.5
	help
	  Specify sever IP address used for tftpboot.

config SPL_LUA_TEST
	bool "Enable Laguna testcases in SPL"
	depends on SPL_UNIT_TEST
	help
	  This enable all laguna testcases in SPL, such as NPU OCM, safety IRAM.

config SPL_LUA_OCM_TEST
	bool "Enable OCM Stress testcase in SPL"
	depends on SPL_LUA_TEST
	help
	  This enables NPU subsystem OCM testcase in SPL.

config SPL_LUA_IRAM_TEST
	bool "Enable Safety IRAM testcase in SPL"
	depends on SPL_LUA_TEST
	help
	  This enables Safety IRAM testcase in SPL.

config LUA_SELECT_UART_FOR_CONSOLE
	bool "Select which UART will use for console"
	help
	  This is able to select given UART as console.

choice
	prompt "UART index"
	depends on LUA_SELECT_UART_FOR_CONSOLE
	default LUA_MAIN_UART1

config LUA_SAFETY_UART0
	bool "Safety UART0"
	select LUA_SAFETY_INIT

config LUA_MAIN_UART1
	bool "Main UART1"

config LUA_MAIN_UART2
	bool "Main UART2"

endchoice

config LUA_CUSTOM_BOOTSTRAP
	bool "Customize Bootstrap Register Value"
	help
	  This option enable us to customize the bootstrap register value
	  used for debugging booting and downloading.

config LUA_BOOTSTRAP_REGADDR
	hex "Bootstrap Register Address"
	depends on LUA_CUSTOM_BOOTSTRAP
	default 0x006D9000
	help
	  Specify a bootstrap register address.

config LUA_BOOTSTRAP_REGVAL
	hex "Bootstrap Register Value"
	depends on LUA_CUSTOM_BOOTSTRAP
	default 0x0
	help
	  Specify a bootstrap register value.

config LUA_CUSTOM_DOWNLOAD_IF
	bool "Customize Download Interface Register Value"
	help
	  This option enable us to customize the download interface register value
	  used for debugging booting and downloading.

config LUA_DOWNLOAD_IF_REGADDR
	hex "Download Interface Register Address"
	depends on LUA_CUSTOM_DOWNLOAD_IF
	default 0x006CF184
	help
	  Specify a download interface register address.

config LUA_DOWNLOAD_IF_REGVAL
	hex "Download Interface Register Value"
	depends on LUA_CUSTOM_DOWNLOAD_IF
	default 0x0
	help
	  Specify a download interface register value.

endmenu

endmenu

config SYS_SOC
	default "laguna"

config SYS_CONFIG_NAME
	default "laguna"

config SYS_VENDOR
	default "axera"

source "board/axera/dvb/laguna/Kconfig"
source "board/axera/qemu-virt/laguna/Kconfig"
source "board/axera/fpga/laguna/Kconfig"
source "board/axera/zebu/laguna/Kconfig"

endif
```

## arch/arm/mach-axera/laguna/spl-fit.its
```
/dts-v1/;

/ {
	description = "Configuration to load ATF before U-Boot";

	images {
		u-boot {
			description = "U-Boot (64-bit)";
			data = /incbin/("u-boot-nodtb.bin");
			type = "standalone";
			os = "u-boot";
			arch = "arm64";
			compression = "none";
			load = <0x4 0x00200000>;
			entry = <0x4 0x00200000>;
			hash {
				algo = "md5";
			};
		};
		atf {
			description = "ARM Trusted Firmware";
			data = /incbin/("bl31.bin");
			type = "firmware";
			os = "arm-trusted-firmware";
			arch = "arm64";
			compression = "none";
			entry = <0x4 0x00104000>;
			load = <0x4 0x00104000>;
			hash {
				algo = "md5";
			};
		};
		fdt_1 {
			description = "laguna-fpga-dtb";
			data = /incbin/("u-boot.dtb");
			type = "flat_dt";
			arch = "arm64";
			compression = "none";
			load = <0x4 0x00300000>;
			hash {
				algo = "md5";
			};
		};
	};
	configurations {
		default = "config_1";

		config_1 {
			description = "laguna-qemu-virt";
			firmware = "atf";
			loadables = "u-boot";
			fdt = "fdt_1";
		};
	};
};
```
