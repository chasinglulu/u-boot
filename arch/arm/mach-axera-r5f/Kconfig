## arch/arm/mach-axera/lambert/Kconfig
```kconfig
if AXERA_LMT

choice
	prompt "Axera Lambert SoC board select"

config TARGET_LMT_DVB
	bool "Lambert SoC Development Verification board"
	select LMT_SOC
	help
	  Lambert DVB is a development board for Axera Lambert SoC,
	  with full function and physical connectors support like MIPI,
	  JTAG, MAC, SD card, CAN, QSPI, PCIe, USB-to-serial...

config TARGET_LMT_VIRT
	bool "Lambert Virtual Qemu Development board"
	select LMT_SOC
	help
	  lmt-virt is a virtual development board for Axera Lambert SoC based on QEMU,
	  with a few part of function and physical connectors support
	  like eMMC, MAC, SDIO, GPIO, I2C, PCIe...

config TARGET_LMT_FPGA
	bool "Lambert FPGA Verification board"
	select LMT_DW8250
	select LMT_SOC
	help
	  FPGA is a verification board for Axera Lambert SoC,
	  with a little function and physical connectors support like UART,
	  JTAG, eMMC, PCIe, USB-to-serial...

endchoice

config LMT_SOC
	bool

config SYS_MALLOC_F_LEN
	default 0x4000

menu "Lambert SoC features"

config LMT_DRAM_BASE
	hex "Lamert DRAM Address Space Base"
	depends on LMT_SOC
	default 0x400000000

menu "SPL Load Images"
	depends on SPL

config LMT_SPL_ATF_LOAD_ADDR
	hex "ATF firmware load address"
	depends on LMT_SOC
	default 0x400104000

config LMT_SPL_OPTEE_LOAD_ADDR
	hex "OP-TEE firmware load address"
	depends on LMT_SOC
	default 0x404000000

endmenu

menu "U-Boot Load Images"
config LMT_SCRIPT_LOAD_ADDR
	hex "Boot script load address"
	depends on LMT_SOC
	default 0x40f000000

config LMT_KERNEL_LOAD_NAME
	string "Kernel image name"
	default Image

config LMT_KERNEL_LOAD_ADDR
	hex "Kernel image load address"
	depends on LMT_SOC
	default 0x410000000

config LMT_KERNEL_COMP_ADDR
	hex "Kernel image decompression address"
	default 0x420000000

config LMT_KERNEL_COMP_SIZE
	hex "Kernel image decompression buffer size"
	default 0x04000000

config LMT_FDT_LOAD_NAME
	string "FDT image name"
	default "lambert-virt.dtb"

config LMT_FDT_LOAD_ADDR
	hex "DTB image load address"
	depends on LMT_SOC
	default 0x418000000

config LMT_RAMDISK_LOAD_NAME
	string "initramfs image load name"
	default "rootfs.cpio.gz"

config LMT_RAMDISK_LOAD_ADDR
	hex "initramfs image load address"
	depends on LMT_SOC
	default 0x419000000

endmenu

config LMT_SWITCH_TO_EL2
	bool "Force switch to EL2"
	help
	  This option is used to switch CPU into EL2 state. When verifying on the FPGA,
	  there is no BL31 environment, and the CPU cannot directly enter the EL2 state,
	  so it is necessary to switch the CPU to the EL2 state when U-boot starts executing.

config LMT_ENABLE_GICV2
	bool "Enable GICv2"
	select GICV2
	help
	  This option enables GIC-400. When running on an FPGA alone,
	  we can initialize GIC without BL31, configure security related settings,
	  and complete the same initialization configuration of GIC as BL31.

source "board/axera/common/Kconfig"

endmenu

config SYS_SOC
	default "lambert"

config SYS_CONFIG_NAME
	default "lambert" if LMT_SOC

config SYS_VENDOR
	default "axera"

source "board/axera/dvb/Kconfig"
source "board/axera/qemu-virt/Kconfig"
source "board/axera/fpga/Kconfig"

endif
```

## arch/arm/mach-hobot/Kconfig
```kconfig
if ARCH_HOBOT

config HOBOT_J5
	bool "Support Horizon Robotics Jounery 5 SoC"
	select ARM64
	select DM_I2C
	select DM_ETH
	help
	  The Journey 5 is a ARM-based SoC with a eight-core Cortex-A55
	  and dual-core BPU.
	  including 2M SRAM, 128K L2 cache per core, 2M L3 cache, dual-core
	  lockstep Cortex-M and DSP, two DDR4 controller and video codec support.
	  Peripherals include Gigabit Ethernet, MIPI, PCIe, eMMC, I2S, UARTs, SPI,
	  I2C and PWMs.

config HOBOT_J6
	bool "Support Horizon Robotics Jounery 6 SoC"
	select ARM64
	select DM_I2C
	select DM_ETH
	select DM_USB
	help
	  The Journey 6 is a ARM-based SoC with a eight-core Cortex-A78AE
	  and dual-core BPU.
	  including 2M SRAM, 128K L2 cache per core, 2M L3 cache, dual-core
	  lockstep Cortex-M and DSP, two DDR4 controller and video codec support.
	  Peripherals include Gigabit Ethernet, MIPI, PCIe, eMMC, I2S, UARTs, SPI,
	  I2C and PWMs.

source "arch/arm/mach-hobot/j5/Kconfig"
source "arch/arm/mach-hobot/j6/Kconfig"

endif
```

## arch/arm/mach-hobot/j5/Kconfig
```kconfig
if HOBOT_J5

choice
	prompt "Hobot Jounery 5 board select"

config TARGET_DVB_J5
	bool "J5 Development Verification board"
	help
	  J5DVB is a development board for Hobot Jounery 5 SoC,
	  with full function and physical connectors support like MIPI,
	  JTAG, MAC, SD card, CAN, QSPI, PCIe, USB-to-serial...


endchoice

config SYS_SOC
	default "hobot"

config SYS_MALLOC_F_LEN
	default 0x4000

source "board/hobot/j5dvb/Kconfig"

endif
```

## arch/arm/mach-hobot/j6/Kconfig
```kconfig
if HOBOT_J6

choice
	prompt "Hobot Jounery 6 board select"

config TARGET_DVB_J6P
	bool "J6P Development Verification board"
	select HOBOT_J6P
	select TARGET_DVB
	help
	  J6PDVB is a development board for Hobot Jounery 6 Pro SoC,
	  with full function and physical connectors support like MIPI,
	  JTAG, MAC, SD card, CAN, QSPI, PCIe, USB-to-serial...

config TARGET_VIRT_SIGIP
	bool "Virtual SigiP Development board"
	select HOBOT_J6P
	select TARGET_VIRT
	help
	  Virt-Sigi is a virtual development board for Hobot sigip SoC based on QEMU,
	  with a few part of function and physical connectors support
	  like eMMC, MAC, SDIO, GPIO, I2C, PCIe, USB...

config TARGET_FPGA_J6P
	bool "J6P FPGA Verification board"
	select HOBOT_DW8250
	select HOBOT_J6P
	select TARGET_FPGA
	help
	  FPGA is a verification board for Hobot Jounery 6 Pro SoC,
	  with a little function and physical connectors support like UART,
	  JTAG, eMMC, PCIe, USB-to-serial...

config TARGET_DVB_J6E
	bool "J6E Development Verification board"
	select HOBOT_J6E
	select TARGET_DVB
	help
	  J6EDVB is a development board for Hobot Jounery 6 Edition SoC,
	  with full function and physical connectors support like MIPI,
	  JTAG, MAC, SD card, CAN, QSPI, PCIe, USB-to-serial...

config TARGET_VIRT_SIGIE
	bool "Virtual SigiE Development board"
	select HOBOT_J6E
	select TARGET_VIRT
	help
	  Virt-SigiE is a virtual development board for Hobot sigie SoC based on QEMU,
	  with a few part of function and physical connectors support
	  like eMMC, MAC, SDIO, GPIO, I2C, PCIe, USB...

config TARGET_FPGA_J6E
	bool "J6E FPGA Verification board"
	select HOBOT_DW8250
	select HOBOT_J6E
	select TARGET_FPGA
	help
	  FPGA is a verification board for Hobot Jounery 6 Edition SoC,
	  with a little function and physical connectors support like UART,
	  JTAG, eMMC, PCIe, USB-to-serial...

endchoice

config HOBOT_J6P
	bool

config HOBOT_J6E
	bool

config TARGET_FPGA
	bool

config TARGET_DVB
	bool

config TARGET_VIRT
	bool

config SYS_SOC
	default "hobot"

config SYS_MALLOC_F_LEN
	default 0x4000


menu "Horizon Robotics Journey 6 SoC features"

config SYS_NON_INTER_DDR_BASE
	hex "Non-interleave DDR Base Address"
	depends on HOBOT_J6P
	default 0x3000000000

config SYS_INTERLEAVE_DDR_BASE
	hex "Interleave DDR Base Address"
	depends on HOBOT_J6P
	default 0x1000000000

config SYS_OCM_BASE
	hex "On-Chip SRAM Base Address"
	depends on HOBOT_J6P
	default 0x04000000

config SYS_J6E_LOW_DDR_BASE
	hex "J6E Low DDR Base Address"
	depends on HOBOT_J6E
	default 0x80000000

config SYS_J6E_HIGH_DDR_BASE
	hex "J6E High DDR Base Address"
	depends on HOBOT_J6E
	default 0x400000000

config HOBOT_SWITCH_TO_EL2
	bool "Force switch to EL2"
	help
	  This option is used to switch CPU into EL2 state. When verifying on the FPGA,
	  there is no BL31 environment, and the CPU cannot directly enter the EL2 state,
	  so it is necessary to switch the CPU to the EL2 state when U-boot starts executing.

source "board/hobot/common/Kconfig"

endmenu

config SYS_CONFIG_NAME
	default "hobot-j6e" if HOBOT_J6E
	default "hobot-j6" if HOBOT_J6P

source "board/hobot/j6dvb/Kconfig"
source "board/hobot/virt-sigi/Kconfig"
source "board/hobot/fpga/Kconfig"

endif
```

## board/axera/common/laguna/Kconfig
```kconfig
config LUA_MTDPARTS_READ
	bool "Allow MTDPARTS to be read at runtime"
	depends on SYS_MTDPARTS_RUNTIME
	depends on AXERA_LUA
	help
	  This option allows us to dynamically build the variables mtdids
	  and mtdparts at runtime for booting.

config LUA_MTDPARTS_FROM_MTDBLOCK
	bool "Read MTDPARTS from mtdblock device"
	depends on LUA_MTDPARTS_READ
	help
	  This option reads the mtdparts string from a mtdblock device.
	  Fixed partitions defined in the menu below will be used to
	  determine the mtdparts string location.

config LUA_MTDPARTS_FROM_BUFFER
	bool "Read MTDPARTS from a buffer"
	depends on LUA_MTDPARTS_READ
	depends on !SPI_FLASH_PROBE_ALL
	help
	  This option reads the mtdparts string from a buffer.

menu "Fixed partitions on MTDBlock device"
	depends on LUA_MTDPARTS_FROM_MTDBLOCK

config LUA_SBL_SIZE_IN_NORFLASH
	hex "SBL Partition Size in NOR Flash"
	default 0x20000
	help
	  This defines the size of SBL partition in NOR Flash.

config LUA_SBL_SIZE_IN_NANDFLASH
	hex "SBL Partition Size in NAND Flash"
	default 0xC0000
	help
	  This defines the size of SBL partition in NAND Flash.

config LUA_SBL_SIZE_IN_HYPERFLASH
	hex "SBL Partition Size in Hyper Flash"
	default 0x40000
	help
	  This defines the size of SBL partition in Hyper Flash.

config LUA_METADATA_SIZE_IN_NORFLASH
	hex "Metadata Partition Size in NOR Flash"
	default 0x20000
	help
	  This defines the size of Metadata partition in NOR Flash.

config LUA_METADATA_SIZE_IN_NANDFLASH
	hex "Metadata Partition Size in NAND Flash"
	default 0xC0000
	help
	  This defines the size of Metadata partition in NAND Flash.

config LUA_METADATA_SIZE_IN_HYPERFLASH
	hex "Metadata Partition Size in Hyper Flash"
	default 0x40000
	help
	  This defines the size of Metadata partition in Hyper Flash.

endmenu

config LUA_SPI_NOR_RUNTIME
	bool "Allow SPI NOR to be configured at runtime"
	depends on SYS_MTDPARTS_RUNTIME
	depends on AXERA_LUA
	help
	  This option allows us to dynamically build the variables mtdids
	  and mtdparts at runtime for SPI NOR Flash.

if LUA_SPI_NOR_RUNTIME

config LUA_NOR0
	bool "SPI NOR Flash Settings for nor0"
	help
	  This enables settings for first SPI NOR Flash.

config LUA_MTDPARTS_NOR0
	string "MTD Partitions for nor0"
	depends on LUA_NOR0
	help
	  This defines the partitions of nor0 used to build mtparts dynamically
	  for booting.

config LUA_NOR1
	bool "SPI NOR Flash Settings for nor1"
	depends on SYS_MTDPARTS_RUNTIME
	depends on AXERA_LUA
	help
	  This enables settings for second SPI NOR Flash.

config LUA_MTDPARTS_NOR1
	string "MTD Partitions for nor1"
	depends on LUA_NOR1
	help
	  This defines the partitions of nor1 used to build mtparts dynamically
	  for booting.

endif

config LUA_SPI_NAND_RUNTIME
	bool "Allow SPI NAND to be configured at runtime"
	depends on SYS_MTDPARTS_RUNTIME
	depends on AXERA_LUA
	help
	  This option allows us to dynamically build the variables mtdids
	  and mtdparts at runtime for SPI NAND Flash.

if LUA_SPI_NAND_RUNTIME

config LUA_NAND0
	bool "SPI NAND Flash Settings for nand0"
	help
	  This enable settings for the first SPI NAND Flash.

config LUA_MTDPARTS_NAND0
	string "MTD Partitions for nand0"
	depends on LUA_NAND0
	help
	  This define the partition of nand0 used to build mtparts dynamically
	  for booting.

endif
```

## board/axera/common/laguna_r5f/Kconfig
```kconfig
config LUA_NOR0
	bool "SPI NOR Flash Settings for nor0"
	depends on SYS_MTDPARTS_RUNTIME
	depends on LUA_R5F
	help
	  This enable settings for first SPI NOR Flash.

config LUA_MTDPARTS_NOR0
	string "MTD Partitions for nor0"
	depends on LUA_NOR0
	help
	  This define the partition of nor0 used to build mtparts dynamically
	  for booting.

config LUA_NOR1
	bool "SPI NOR Flash Settings for nor1"
	depends on SYS_MTDPARTS_RUNTIME
	depends on LUA_R5F
	help
	  This enable settings for second SPI NOR Flash.

config LUA_MTDPARTS_NOR1
	string "MTD Partitions for nor1"
	depends on LUA_NOR1
	help
	  This define the partition of nor1 used to build mtparts dynamically
	  for booting.

config LUA_NAND0
	bool "SPI NAND Flash Settings for nand0"
	depends on SYS_MTDPARTS_RUNTIME
	depends on LUA_R5F
	help
	  This enable settings for the first SPI NAND Flash.

config LUA_MTDPARTS_NAND0
	string "MTD Partitions for nand0"
	depends on LUA_NAND0
	help
	  This define the partition of nand0 used to build mtparts dynamically
	  for booting.
```

## board/axera/common/lambert/Kconfig
```kconfig
config LMT_MTDPARTS_NOR0
	string "mtd boot partition for nor0"
	default "64m(u-boot)" if !TFABOOT
	depends on SYS_MTDPARTS_RUNTIME
	depends on AXERA_LMT
	help
	  This define the partition of nor0 used to build mtparts dynamically
	  for boot from nor0.

config LMT_MTDPARTS_NOR1
	string "mtd boot partition for nor1"
	default "64m(u-boot-env)" if !TFABOOT
	depends on SYS_MTDPARTS_RUNTIME
	depends on AXERA_LMT
	help
	  This define the partition of nor1 used to build mtparts dynamically
	  for boot from nor1.
```

## board/axera/riscv-virt/Kconfig
```kconfig
if TARGET_LMT_RISCV_VIRT

config SYS_BOARD
	default "riscv-virt"

config SYS_VENDOR
	default "axera"

config SYS_CPU
	default "generic"

config SYS_CONFIG_NAME
	default "lmt-riscv-virt"

config SYS_MALLOC_LEN
	default 0x40000 if !LMT_RISCV_NO_DRAM
	default 0x10000 if LMT_RISCV_NO_DRAM

config ENV_SIZE
	default 0x10000 if LMT_RISCV_NO_DRAM

config SYS_TEXT_BASE
	default 0x60c20000 if LMT_RISCV_NO_DRAM
	default 0x60e00000 if !LMT_RISCV_NO_DRAM

config SPL_TEXT_BASE
	default 0x60c00000

config SPL_OPENSBI_LOAD_ADDR
	hex
	default 0x60f00000 if ! LMT_RISCV_NO_DRAM

config BOARD_SPECIFIC_OPTIONS # dummy
	def_bool y
	select GENERIC_RISCV
	select SUPPORT_SPL
	select CPU
	select SPL
	imply SMP
	imply BOARD_LATE_INIT
	imply SPL_RAM_SUPPORT
	imply SPL_RAM_DEVICE
	imply SYS_NS16550
	imply SIFIVE_SERIAL

menu "Lambert RISC-V Features"

config LMT_RISCV_NO_DRAM
	bool "No available DRAM on Lambert RISC-V"
	help
	  Enable this to disable DRAM support.

endmenu

endif
```

## board/hobot/fpga/Kconfig
```kconfig
if TARGET_FPGA
config SYS_BOARD
	default "fpga"

config SYS_VENDOR
	default "hobot"
endif
```

## board/hobot/j5dvb/Kconfig
```kconfig
if TARGET_DVB_J5

config SYS_BOARD
	default "j5dvb"

config SYS_VENDOR
	default "hobot"

config SYS_CONFIG_NAME
	default "hobot-j5"

endif
```

## board/hobot/j6dvb/Kconfig
```kconfig
if TARGET_DVB

config SYS_BOARD
	default "j6dvb"

config SYS_VENDOR
	default "hobot"

endif
```

## board/hobot/virt-sigi/Kconfig
```kconfig
if TARGET_VIRT

config SYS_BOARD
	default "virt-sigi"

config SYS_VENDOR
	default "hobot"

endif
```

## board/samsung/x4412/Kconfig
```kconfig
if TARGET_X4412

config SYS_BOARD
	default "x4412"

config SYS_VENDOR
	default "samsung"

config SYS_CONFIG_NAME
	default "x4412"

config X4412
        bool "9tripod X4412 development board"
        default y

config EXYNOS4412
        bool "Samsung Exynos4412 SoC"
        default y

config EXYNOS4412_SECURE_BOOT
        bool "secure boot support by Exynos4412 SoC"
        default y
endif
```
